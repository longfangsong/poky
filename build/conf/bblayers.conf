## build/conf/bblayers.conf
```bitbake
# POKY_BBLAYERS_CONF_VERSION is increased each time build/conf/bblayers.conf
# changes incompatibly
POKY_BBLAYERS_CONF_VERSION = "2"

BBPATH = "${TOPDIR}"
BBFILES ?= ""

BBLAYERS ?= " \
  /home/longfangsong/Project/poky/meta \
  /home/longfangsong/Project/poky/meta-poky \
  /home/longfangsong/Project/poky/meta-yocto-bsp \
  /home/longfangsong/Project/poky/meta-openembedded/meta-oe \
  /home/longfangsong/Project/poky/meta-openembedded/meta-python \
  /home/longfangsong/Project/poky/meta-openembedded/meta-networking \
  /home/longfangsong/Project/poky/meta-mock-sensor \
  /home/longfangsong/Project/poky/meta-middleware \
  /home/longfangsong/Project/poky/build/workspace \
  "
```
